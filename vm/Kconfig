## vm/Kconfig
```kconfig
mainmenu "Picobit Virtual Machine Configuration"

choice
	prompt "Target architecture"
	help
	  Select a platform to run Picobit VM on.
	  

	config	ARCH_HOST
		bool "Host executable"
		select ARCH_32BIT
		select ERROR_HANDLING
		select DEBUG_STRINGS
		help
		  Build Picobit as a host (Linux) executable for easy
		  debugging.
		  

	config	ARCH_ARM
		bool "ARM microcontrollers"
		select ARCH_32BIT

	config	ARCH_ARDUINO
		bool "Arduino"
		select ARCH_8BIT
endchoice

config ERROR_HANDLING
	bool

config DEBUG_STRINGS
	bool

config ARCH_8BIT
	bool

config ARCH_32BIT
	bool

config ARCH
	string
	default "host" if ARCH_HOST
	default "arm" if ARCH_ARM
	default "arduino" if ARCH_ARDUINO

if ARCH_HOST
source "arch/host/Kconfig"
endif

if ARCH_ARM
source "arch/arm/Kconfig"
endif

if ARCH_ARDUINO
source "arch/arduino/Kconfig"
endif

source "core/Kconfig"
```

## vm/arch/arduino/Kconfig
```kconfig
config CROSS_COMPILER
	string "Cross compiler prefix"
	default "avr-"

choice
	prompt "Processor core type"

	config ARDUINO_UNO
	bool "Arduino Uno"

	config ARDUINO_NANO
	bool "Arduino Nano"

	config ARDUINO_PROMINI_16
	bool "Arduino Pro Mini 5V/16MHz"

	config ARDUINO_PROMINI_8
	bool "Arduino Pro Mini 3.3V/8MHz"

	config ARDUINO_LEONARDO
	bool "Arduino Leonardo (not supported yet)"
endchoice

config CFLAGS
        string
	default "-mmcu=atmega328p -DF_CPU=16000000" if ARDUINO_UNO
	default "-mmcu=atmega328p -DF_CPU=16000000" if ARDUINO_NANO
	default "-mmcu=atmega328p -DF_CPU=16000000" if ARDUINO_PROMINI_16
	default "-mmcu=atmega328p -DF_CPU=8000000" if ARDUINO_PROMINI_8

config NETWORKING
	bool "Networking"
	help
	 Enable support for networking devices.

choice
	prompt "Network interface" if NETWORKING
	help
	 Select the network interface to use.

	config NETWORKING_SLIP
		bool "SLIP"
		help
		 Plain Serial Line Internet Protocol over hardware serial line.

	config NETWORKING_ENC28J60
		bool "Microchip ENC28J60"

	config NETWORKING_W5x00
		bool "Wiznet W5100/W5200"

endchoice
```
